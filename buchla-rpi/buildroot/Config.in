## buchla-rpi/buildroot/Config.in
```kconfig
source "$BR2_EXTERNAL_BUCHLA_PATH/package/buchla-emu/Config.in"
source "$BR2_EXTERNAL_BUCHLA_PATH/package/rtmidi/Config.in"
```

## buchla-rpi/buildroot/configs/buchla700_rpi3_defconfig
```kconfig
# Buchla 700 — Raspberry Pi 3B+ defconfig
# Based on Buildroot raspberrypi3_64_defconfig

# Architecture
BR2_aarch64=y
BR2_ARM_FPU_VFPV4=y

# Toolchain — pre-built Bootlin (much faster than building from scratch)
BR2_TOOLCHAIN_EXTERNAL=y
BR2_TOOLCHAIN_EXTERNAL_BOOTLIN=y
BR2_TOOLCHAIN_EXTERNAL_BOOTLIN_AARCH64_GLIBC_STABLE=y

# System
BR2_TARGET_GENERIC_HOSTNAME="buchla700"
BR2_TARGET_GENERIC_ISSUE="Buchla 700"
BR2_SYSTEM_DHCP="eth0"
BR2_TARGET_GENERIC_ROOT_PASSWD="buchla"
BR2_TARGET_GENERIC_GETTY_PORT="tty1"
BR2_GLOBAL_PATCH_DIR="board/raspberrypi/patches"
BR2_ROOTFS_OVERLAY="$(BR2_EXTERNAL_BUCHLA_PATH)/overlay"
BR2_ROOTFS_POST_BUILD_SCRIPT="board/raspberrypi3-64/post-build.sh"
BR2_ROOTFS_POST_IMAGE_SCRIPT="board/raspberrypi3-64/post-image.sh"

# Kernel
BR2_LINUX_KERNEL=y
BR2_LINUX_KERNEL_CUSTOM_TARBALL=y
BR2_LINUX_KERNEL_CUSTOM_TARBALL_LOCATION="$(call github,raspberrypi,linux,21b410140c47ffab5668399f6f143c7d7b935c8b)/linux-21b410140c47ffab5668399f6f143c7d7b935c8b.tar.gz"
BR2_LINUX_KERNEL_DEFCONFIG="bcm2711"
BR2_LINUX_KERNEL_CONFIG_FRAGMENT_FILES="$(BR2_EXTERNAL_BUCHLA_PATH)/kernel-fragment.cfg"
BR2_LINUX_KERNEL_DTS_SUPPORT=y
BR2_LINUX_KERNEL_INTREE_DTS_NAME="broadcom/bcm2710-rpi-3-b-plus"
BR2_LINUX_KERNEL_NEEDS_HOST_OPENSSL=y

# Firmware
BR2_PACKAGE_RPI_FIRMWARE=y
BR2_PACKAGE_RPI_FIRMWARE_BOOTCODE_BIN=y
BR2_PACKAGE_RPI_FIRMWARE_VARIANT_PI=y
BR2_PACKAGE_RPI_FIRMWARE_CONFIG_FILE="$(BR2_EXTERNAL_BUCHLA_PATH)/config_buchla.txt"

# Audio
BR2_PACKAGE_ALSA_LIB=y
BR2_PACKAGE_ALSA_LIB_PCM_PLUGINS="hw plug"
BR2_PACKAGE_ALSA_UTILS=y
BR2_PACKAGE_ALSA_UTILS_AMIXER=y
BR2_PACKAGE_ALSA_UTILS_APLAY=y

# Graphics (KMS/DRM for SDL2)
BR2_PACKAGE_LIBDRM=y
BR2_PACKAGE_MESA3D=y
BR2_PACKAGE_MESA3D_GALLIUM_DRIVER_V3D=y
BR2_PACKAGE_MESA3D_OPENGL_EGL=y
BR2_PACKAGE_MESA3D_OPENGL_ES=y

# SDL2
BR2_PACKAGE_SDL2=y
BR2_PACKAGE_SDL2_KMSDRM=y
BR2_PACKAGE_SDL2_OPENGLES=y
BR2_PACKAGE_SDL2_NET=y
BR2_PACKAGE_SDL2_TTF=y

# Fonts
BR2_PACKAGE_FREETYPE=y
BR2_PACKAGE_HARFBUZZ=y

# WiFi
BR2_PACKAGE_LINUX_FIRMWARE=y
BR2_PACKAGE_LINUX_FIRMWARE_BRCM_BCM43XX=y
BR2_PACKAGE_WPA_SUPPLICANT=y
BR2_PACKAGE_WPA_SUPPLICANT_NL80211=y
BR2_PACKAGE_WPA_SUPPLICANT_AP_SUPPORT=y

# SSH (for remote debugging — no more reflashing for config changes)
BR2_PACKAGE_DROPBEAR=y

# MIDI
BR2_PACKAGE_RTMIDI=y

# Buchla emulator
BR2_PACKAGE_BUCHLA_EMU=y

# Allow kmod to override BusyBox modprobe (needed for .ko.xz modules)
BR2_PACKAGE_BUSYBOX_SHOW_OTHERS=y
BR2_PACKAGE_KMOD=y
BR2_PACKAGE_KMOD_TOOLS=y

# Filesystem
BR2_TARGET_ROOTFS_EXT2=y
BR2_TARGET_ROOTFS_EXT2_4=y
BR2_TARGET_ROOTFS_EXT2_SIZE="120M"
# BR2_TARGET_ROOTFS_TAR is not set

# SD card image
BR2_PACKAGE_HOST_DOSFSTOOLS=y
BR2_PACKAGE_HOST_GENIMAGE=y
BR2_PACKAGE_HOST_KMOD_XZ=y
BR2_PACKAGE_HOST_MTOOLS=y
```

## buchla-rpi/buildroot/package/buchla-emu/Config.in
```kconfig
config BR2_PACKAGE_BUCHLA_EMU
	bool "buchla-emu"
	depends on BR2_PACKAGE_SDL2
	depends on BR2_PACKAGE_SDL2_NET
	depends on BR2_PACKAGE_SDL2_TTF
	depends on BR2_PACKAGE_ALSA_LIB
	depends on BR2_PACKAGE_RTMIDI
	help
	  Buchla 700 synthesizer emulator.
```

## buchla-rpi/buildroot/package/rtmidi/Config.in
```kconfig
config BR2_PACKAGE_RTMIDI
	bool "rtmidi"
	depends on BR2_PACKAGE_ALSA_LIB
	depends on BR2_INSTALL_LIBSTDCPP
	help
	  RtMidi - realtime MIDI input/output library.

	  https://github.com/thestk/rtmidi
```
